/* Sketch was generated by motoblockly 
 Website: http://www.motoblockly.com 
 Author: www.motoduino.com 
 Date: Wed Apr 04 2018 12:36:04 GMT+0800
 */ 
#include <Wire.h>
#include <motoLiquidCrystal_I2C.h>
#include "motoWiFiEsp.h"

#include <SoftwareSerial.h>

#include <motoDHT.h>

LiquidCrystal_I2C mylcd(0x27,16,2);

SoftwareSerial esp8266_Serial(3,2);

WiFiEspClient esp_client;

int connect_status = WL_IDLE_STATUS;

String ipAddressToString(const IPAddress& ipAddress ) {
       return String(ipAddress[0]) + String(".")+
       String(ipAddress[1]) + String(".")+
       String(ipAddress[2]) + String(".")+
       String(ipAddress[3]);
}
float Temperature_LM35T_A3(int tempUnit) {
int readtempValue = analogRead(A3);
float temperature = (readtempValue * 0.49);
if(tempUnit == 1)
   return temperature;
 else
   return ((temperature * 1.8) + 32);
}

String  LM35Temp;
DHT motoDHT(4, DHT11);

String  DH11Temp;
String  DH11Hum;
void showLCD(String s1, String s2) {
  mylcd.clear();
  mylcd.setCursor(0,0);
  mylcd.print(s1);
  mylcd.setCursor(0,1);
  mylcd.print(s2);
}

void showGreenLED() {
  digitalWrite(10,HIGH);
  delay(1);
  digitalWrite(10,LOW);
}

void setup()
{
  pinMode(12, OUTPUT);
  mylcd.init();

  mylcd.backlight();

  Serial.begin(9600);
  esp8266_Serial.begin(9600);

  pinMode(A3, INPUT);
  pinMode(4, INPUT);
  motoDHT.begin();
    digitalWrite(12,HIGH);
  Serial.println("Welcome Arduino Weather Station");
  showLCD("Welcome Arduino", "Weather Station");
  showGreenLED();
  esp8266_Serial.listen();
  WiFi.init(&esp8266_Serial); 
  if(WiFi.status()==WL_NO_SHIELD) {
   Serial.println("Esp8266 module no present");
   while(true);
   }
  while(connect_status != WL_CONNECTED) {
   Serial.println("Connect to router...");
   connect_status = WiFi.begin("WiFi","0928583777");
  }
  Serial.println((String("IP: ") + String(ipAddressToString(WiFi.localIP()))));
  showLCD(String("IP: ") + String(ipAddressToString(WiFi.localIP())), "");

  pinMode(10, OUTPUT);
}


void loop()
{
    LM35Temp = Temperature_LM35T_A3(1);
    DH11Temp = motoDHT.readTemperature();
    DH11Hum = motoDHT.readHumidity();
    showGreenLED();
    esp8266_Serial.listen();
    if (esp_client.connect("maker.ifttt.com", 80)) {
         String data = "\r\n{\"value1\":"+ String(LM35Temp)+",\"value2\": "+String(DH11Temp)+",\"value3\": "+String(DH11Hum)+"}";
         esp_client.println("POST /trigger/WeatherStation/with/key/dJ0-E_fOYQY5koTywIKRIC HTTP/1.1");
         esp_client.println("Host: maker.ifttt.com");
         esp_client.println("User-Agent: Arduino");
         esp_client.println("Accept: */*");
         esp_client.print("Content-Length: ");
         esp_client.println(data.length());
         esp_client.println("Content-Type: application/json");
         esp_client.println("Connection: close");
         esp_client.println(data);
    }
    esp_client.stop();
    Serial.println((String("LM35 TEMP: ") + String(LM35Temp) + String("℃, DHT11 TEMP: ") + String(DH11Temp) + String("℃, DHT11 HUM: ") + String(DH11Hum) + String("%")));
    showLCD(String("TEMP: ") + String(DH11Temp) + String("\x0DF") + String("C"), String(" HUM: ") + String(DH11Hum) + String("%"));
    delay(60000);

}
